## arch/arm/mach-gc1601/Kconfig
```kconfig
#
# arch/arm/mach-gc1601/Kconfig
#

if MACH_GC1601

menu "Faraday GC1601 Platform Options"
	depends on MACH_GC1601

config MACH_GC1601_VP
	bool "Faraday GC1601 VP"
	help
	  Say Y here if you are using FARADAY GC1601 VP

endmenu

endif
```

## arch/arm/mach-tc12ngrc/Kconfig
```kconfig
#
# arch/arm/mach-tc12ngrc/Kconfig
#

if MACH_TC12NGRC

menu "Faraday TC12NGRC Platform Options"
	depends on MACH_TC12NGRC

config UART_CLOCK
	int "UART clock tick rate"
	default 18432000 if MACH_TC12NGRC
	help
	  The frequency of the UART reference clock.

endmenu

endif
```

## arch/arm/plat-faraday/Kconfig
```kconfig
#
# SoC
#
choice
	prompt "Faraday Platform Type"
	default MACH_A380
	depends on ARCH_FARADAY

config MACH_A380
	bool "A380"
	select ARM_GIC if CPU_CA9
	select FARADAY_FTINTC030 if CPU_FA626TE
	select FARADAY_FTINTC030_SPI_TARGET_INVERSE if CPU_FA626TE
	select HAVE_ARM_SCU if SMP
	select HAVE_ARM_TWD if SMP
	select FTTMR010
	select FTSCU100
	select ARCH_REQUIRE_GPIOLIB
	select PINCTRL
	select PINCTRL_A380
	select PINCTRL_FTSCU010
	select SND_SOC_WM8731
	select VIRT_TO_BUS
	select WIRELESS_EXT
	select WEXT_PRIV
	select COMMON_CLK
	select TIMER_OF if OF

config MACH_GC1601
	bool "GC1601"
	select FARADAY_FTINTC030
	select FTTMR010
	select CPU_ARM926T if MACH_GC1601_VP
	select CPU_FA626TE if !MACH_GC1601_VP
	select ARCH_REQUIRE_GPIOLIB
	select PINCTRL
	select PINCTRL_GC1601
	select PINCTRL_FTSCU010
	select VIRT_TO_BUS
	select WIRELESS_EXT
	select WEXT_PRIV
	select COMMON_CLK
	select TIMER_OF if OF

config MACH_LEO
	bool "LEO"
	select ARM_GIC
	select FTSCU100
	select ARCH_REQUIRE_GPIOLIB
	select PINCTRL
	select PINCTRL_LEO
	select PINCTRL_FTSCU010
	select PINCTRL_FTSCU010_GROUP
	select PM_OPP
	select SND_SOC_WM8731
	select VIRT_TO_BUS
	select WIRELESS_EXT
	select WEXT_PRIV
	select COMMON_CLK
	select TIMER_OF if OF
	select ARM_ARCH_TIMER
	select FTPWMTMR010
#	select ARM_LPAE

config MACH_TC12NGRC
	bool "TC12NGRC"
	select FARADAY_FTINTC020
#	select FARADAY_FTINTC020_VEC
	select FTTMR010
#	select FTPWMTMR010
	select CPU_ARM926T
	select ARCH_REQUIRE_GPIOLIB
	select PINCTRL
	select PINCTRL_TC12NGRC
	select PINCTRL_FTSCU010
	select VIRT_TO_BUS
	select WIRELESS_EXT
	select WEXT_PRIV
	select COMMON_CLK
	select TIMER_OF if OF

endchoice

#
# Core drivers
#

config CPU_HAS_GIC
	bool
	default y if CPU_FMP626 || CPU_CA9
	help
	  Use ARM GIC
```

## drivers/pinctrl/faraday/Kconfig
```kconfig
if ARCH_FARADAY || COMPILE_TEST

config PINCTRL_FTSCU010
	bool
	select PINMUX

config PINCTRL_FTSCU010_GROUP
	bool
	depends on PINCTRL_FTSCU010

config PINCTRL_A380
	bool "Faraday A380 pin controller driver"
	depends on MACH_A380
	select PINCTRL_FTSCU010

config PINCTRL_A500
	bool "Faraday A500 pin controller driver"
	depends on A500_PLATFORM
	select PINCTRL_FTSCU010
	select PINCTRL_FTSCU010_GROUP

config PINCTRL_GC1601
	bool "Faraday PINCTRL_GC1601 pin controller driver"
	depends on MACH_PINCTRL_GC1601
	select PINCTRL_FTSCU010

config PINCTRL_GC1610
	bool "Faraday PINCTRL_GC1610 pin controller driver"
	depends on GC1610_PLATFORM
	select PINCTRL_FTSCU010

config PINCTRL_LEO
	bool "Faraday LEO pin controller driver"
	depends on MACH_LEO
	select PINCTRL_FTSCU010

if PINCTRL_LEO
	config PINCTRL_LEO_MODEX
	bool "Enable ModeX"
endif

config PINCTRL_TC12NGRC
	bool "Faraday TC12NGRC pin controller driver"
	depends on MACH_TC12NGRC
	select PINCTRL_FTSCU010

endif
```

## drivers/reset/faraday/Kconfig
```kconfig
# SPDX-License-Identifier: GPL-2.0-only
config COMMON_RESET_A500
	tristate "Faraday A500 Reset Driver"
	depends on A500_PLATFORM
	help
	  Build the Faraday A500 reset driver.

config COMMON_RESET_A600
	tristate "Faraday A600 Reset Driver"
	depends on A600_PLATFORM
	help
	  Build the Faraday A600 reset driver.

config COMMON_RESET_GC1610
	tristate "Faraday GC1610 Reset Driver"
	depends on GC1610_PLATFORM
	help
	  Build the Faraday GC1610 reset driver.
```
